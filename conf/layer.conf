## conf/layer.conf
```bitbake
#We have a conf and classes directory, add to BBPATH
BBPATH .= ":${LAYERDIR}"

# We have recipes-* directories, add to BBFILES
BBFILES += "${LAYERDIR}/recipes-*/*/*.bb \
	${LAYERDIR}/recipes-*/*/*.bbappend"

BBFILE_COLLECTIONS += "meta-rwt-carbon808"
BBFILE_PATTERN_meta-rwt-carbon808 = "^${LAYERDIR}/"
BBFILE_PRIORITY_meta-rwt-carbon808 = "9"

LAYERSERIES_COMPAT_meta-rwt-carbon808 = "scarthgap"
```

## conf/machine/carbon808.conf
```bitbake
#@TYPE: Machine
#@NAME: carbon808
#@DESCRIPTION:  Machine support for carbon808, a TRENZ TE0820 withe a custom RWT carrier card and RF cards
IMAGE_FSTYPES ?= "tar.gz wic"
WKS_FILES = "sdimage-8G.wks"

IMAGE_BOOT_FILES = "${@get_default_image_boot_files(d)}"

# CG is the lowest common demoninator, so use this by default
SOC_VARIANT ?= "eg"

# Yocto device-tree variables
YAML_CONSOLE_DEVICE_CONFIG:pn-device-tree ?= "psu_uart_0"
YAML_MAIN_MEMORY_CONFIG:pn-device-tree ?= "PSU_DDR_0"
DT_PADDING_SIZE:pn-device-tree ?= "0x1000"
DTC_FLAGS:pn-device-tree = "-@"
YAML_DT_BOARD_FLAGS ?= "{BOARD zcu102-rev1.0}"

# Yocto ZynqMP u-boot-xlnx variables
UBOOT_MACHINE ?= "xilinx_zynqmp_virt_defconfig"
BOOTMODE ?= "generic.root"

# Yocto PMUFW variables
YAML_SERIAL_CONSOLE_STDIN:pn-pmu-firmware ?= "psu_uart_0"
YAML_SERIAL_CONSOLE_STDOUT:pn-pmu-firmware ?= "psu_uart_0"

# Yocto FSBL variables
YAML_SERIAL_CONSOLE_STDIN:pn-fsbl-firmware ?= "psu_uart_0"
YAML_SERIAL_CONSOLE_STDOUT:pn-fsbl-firmware ?= "psu_uart_0"

# Yocto KERNEL Variables
UBOOT_ENTRYPOINT  ?= "0x200000"
UBOOT_LOADADDRESS ?= "0x200000"

# ZynqMP Serial Console
SERIAL_CONSOLES ?= "115200;ttyPS0 115200;ttyPS1"
YAML_SERIAL_CONSOLE_BAUDRATE ?= "115200"

require conf/machine/include/soc-zynqmp.inc
require conf/machine/include/machine-xilinx-default.inc

HDF_MACHINE = "main"


MACHINE_FEATURES = "rtc ext2 ext3 vfat usbhost usbgadget keyboard screen bluetooth"
EXTRA_IMAGEDEPENDS += "libyaml-native python3-cython-native python3-pyyaml-native"

#KMACHINE ?= "zynqmp"
UBOOT_MACHINE = "xilinx_zynqmp_virt_defconfig"
SPL_BINARY ?= "spl/boot.bin"
#KERNEL_FEATURES:append_zynqmp =" bsp/xilinx/overlay.scc"

# Default SD image build onfiguration, use qemu-sd to pad
#IMAGE_CLASSES += "image-types-xilinx-qemu"
#IMAGE_FSTYPES += "wic.qemu-sd"
#WKS_FILES ?= "sdimage-bootpart.wks"

SERIAL_CONSOLE= "115200 ttyPS0"
SERIAL_CONSOLES_CHECK = "${SERIAL_CONSOLES}"


FPGA_MNGR_RECONFIG_ENABLE = "1"

PACKAGECONFIG:append:pn-networkmanager = " nmtui nmcli"

# Remove UHD from the image
PACKAGECONFIG:pn-gnuradio = "qtgui5 grc zeromq logging iio"

IMAGE_BOOT_FILES += " \
        carbon808.dtb \
        boot.bin \
        download.9eg.bin \
        download.15eg.bin \
        "

#PREFERRED_PROVIDER_qemu-native ?= "qemu-xilinx-native"
PREFERRED_PROVIDER_virtual/kernel = "linux-adi"
PREFERRED_PROVIDER_virtual/dtb = "device-tree-carbon808"
PREFERRED_PROVIDER_virtual/bootloader = "u-boot-xlnx"
PREFERRED_PROVIDER_virtual/fsbl = "fsbl"
PREFERRED_PROVIDER_virtual/hdf = "carbon808-bd"
PREFERRED_PROVIDER_virtual/xsa = "carbon808-bd"
PREFERRED_PROVIDER_virtual/bitstream = "carbon808-bd"
PREFERRED_PROVIDER_virtual/xilinx-platform-init = "carbon808-bd"
PREFERRED_PROVIDER_virtual/carbon808-boot = "carbon808-bd"
#PREFERRED_PROVIDER_virtual/pmu-firmware ?= "pmu-firmware"
PREFERRED_PROVIDER_virtual/arm-trusted-firmware = "arm-trusted-firmware"
PREFERRED_PROVIDER_virtual/boot-bin = "xilinx-bootbin"


PREFERRED_VERSION_libgpiod = "1.6.4"

MACHINE_EXTRA_RRECOMMENDS += " kernel-modules"

EXTRA_IMAGEDEPENDS += " \
        virtual/dtb \
        virtual/carbon808-boot \
        u-boot-xlnx-uenv \
        arm-trusted-firmware \
        virtual/pmu-firmware \
        fsbl \
        virtual/boot-bin \
	"

EXTRA_IMAGEDEPENDS:remove = "qemu-xilinx-native"
#WKS_FILE_DEPENDS .= "${@bb.utils.contains('IMAGE_BOOT_FILES', 'carbon808.dtb',   ' virtual/dtb', '', d)}"
#WKS_FILE_DEPENDS .= "${@bb.utils.contains('IMAGE_BOOT_FILES', 'download.2cg.bin',   ' virtual/bitstream', '', d)}"
MACHINE_ESSENTIAL_EXTRA_RDEPENDS .= "${@bb.utils.contains('IMAGE_BOOT_FILES', 'carbon808.dtb',   ' ${PREFERRED_PROVIDER_virtual/dtb}', '', d)}"
```
